/*******************************************************************************
 FileName:     	display_config.c
 Dependencies:
 Processor:	PIC18F46J50
 Hardware:	Porcupine HedgeHog OLED or TESTBED
 Compiler:  	Microchip C18
 Author:        KristofVL
 ******************************************************************************/

#include "display_config.h"


/******************************************************************************/
void up_dispcycle(void) {
    if((++disp_cycle)>MAX_DISPCYCLE) 
        disp_cycle=0; 
}

void disp_init(void) {
    BYTE i;
    for (i = 0; i < DISP_PLOTWINSIZE; i++) {
        abuf[i].x = abuf[i].y = abuf[i].z = lbuf[i] = 0;
    }
    disp_cmd = DISP_CMD_INTRO; // Initialze to intro screen
}

void disp_acc_init(void) {
    oled_reset();
    _oledi(porcpic, PORCPIC_X, 8, 75);
    _oledw("Motion Data",0,3);
}

void disp_time_init(void) {
    oled_reset();
    disp_cmd = 0;
}

void disp_env_init(void) {
    oled_reset();
    _oledi(porcpic, PORCPIC_X, 8, 75);
    _oledw("Ambient Data",0,3);  _oledw("light:",2,7);
    _oledw("thermo:",7,7);  _oledw("`C",7,64);
}

void disp_USB_init(void) {
    oled_reset();
    _oledw("connected",3,9); _oledw("to USB",4,19);
    disp_cmd=0;
}

void disp_init_intro(rom char* n, rom char* v) {
    oled_reset();
    _oledw(n,0,9); _oledw(v,1,15);
    _oledi(porcpic, PORCPIC_X, 8, 75);
    disp_cmd=0;
}

void disp_acc_update(PACC_XYZ accval, char* acc_str) {
    BYTE i;
    oled_put_str(acc_str, 1, 0);
    oled_clearRect(0xB2, 0xB8, OLED_OFFSET, DISP_PLOTWINSIZE);
    // scroll abuf 1 to the left:
    memmove((void*)abuf, (void*)(abuf+1), (DISP_PLOTWINSIZE-1)*sizeof(ACC_XYZ));
    abuf[DISP_PLOTWINSIZE - 1].x = (accval->x)>>3;
    abuf[DISP_PLOTWINSIZE - 1].y = (accval->y)>>3;
    abuf[DISP_PLOTWINSIZE - 1].z = (accval->z)>>3;
    for (i = 1; i < DISP_PLOTWINSIZE; i++) {
        oled_drawVLine(abuf[i].x, abuf[i - 1].x, i, 44);
        oled_drawVLine(abuf[i].y, abuf[i - 1].y, i, 56);
        oled_drawVLine(abuf[i].z, abuf[i - 1].z, i, 72);
    }
    disp_cmd=0;
}

void disp_env_update(BYTE lgt_val, char* lt_str, char* tmp_str)
{
    BYTE i;
    oled_put_str(lt_str, 2, 49);
    oled_put_str(tmp_str, 7, 49);
    oled_clearRect(0xB3, 0xB7, OLED_OFFSET + 6, DISP_PLOTWINSIZE);
    // scroll lbuf 1 to the left:
    memmove((void*)lbuf, (void*)(lbuf + 1),
              (DISP_PLOTWINSIZE-1)*sizeof(UINT8));
    lbuf[DISP_PLOTWINSIZE - 1] = lgt_val;
    for (i = 1; i < DISP_PLOTWINSIZE; i++) {
        oled_drawVLine(lbuf[i], lbuf[i - 1], i + 6, 54);
    }
    disp_cmd=0;
}

void disp_time_update( char* dstr,  char* tstr) {
    _oleds(dstr, 7, 2); _oleds(tstr, 7, 79); // print time & date at bottom
    _oledi(bmp[tstr[0]-48], PORCWF_X, 5, 0);
    _oledi(bmp[tstr[1]-48], PORCWF_X, 5, 30);
    _oledi(bmp[tstr[3]-48], PORCWF_X, 5, 70);
    _oledi(bmp[tstr[4]-48], PORCWF_X, 5, 100);
    _oledw("o", 2, 62); _oledw("o", 4, 62);
    disp_cmd=0;
}

BYTE disp_update_time(void) {
    if ((disp_mode == DISP_MODE_TIME)&&(disp_cycle == 200)) {
        disp_cmd = DISP_CMD_CLOCK; // update clock!
        disp_cycle = 0;
        return 1;
    }
    else return 0;
}

BYTE disp_update_env(void){
    if ((disp_mode == DISP_MODE_LGHT)&&(disp_cycle == 8800)) {
        disp_cmd = DISP_CMD_LGTMP;
        disp_cycle = 0;
        return 1;
    }
    else return 0;
}

BYTE disp_update_accl(void){
    if ((disp_mode == DISP_MODE_ACCL)&&(disp_cycle == 2800)) {
        disp_cmd = DISP_CMD_ACCUP;
        disp_cycle = 0;
        return 1;
    }
    else return 0;
}

BYTE disp_update_init(void){
    if ((disp_mode == DISP_MODE_INIT)&&(disp_cycle ==  MAX_DISPCYCLE)) {
        disp_mode = DISP_MODE_ACCL;
        return 1;
    }
    else return 0;
}

BYTE disp_update_log_time(void) {
    if ((disp_cycle > 100) && (disp_mode == DISP_MODE_TIME)) {
        disp_cmd = DISP_CMD_CLOCK;
        disp_cycle = 0;
        return 1;
    }
    else return 0;
}

// toggle between ACCL, LGHT, and TIME modi:
void disp_user_conf_toggle(void) {
    if (disp_mode >= DISP_MODE_ACCL) {
        if (disp_mode==DISP_MODE_TIME)
            disp_mode=DISP_MODE_ACCL;
        else disp_mode++;
        switch (disp_mode) {
            case DISP_MODE_LGHT: disp_env_init(); break;
            case DISP_MODE_TIME: disp_time_init(); break;
            case DISP_MODE_ACCL: disp_acc_init(); break;
        }
    }
}

void disp_user_log_toggle(void) {
    if (disp_mode == DISP_MODE_TIME) { 
        disp_mode = DISP_MODE_LOGG;
        disp_cmd = DISP_CMD_LOGNG;
    }
    else {  disp_mode = DISP_MODE_TIME;
            disp_time_init();
            disp_cycle = 101; // refresh soon..
    }
}

DISP_CMD disp_refresh(void) {
    switch (disp_cmd) {
        case DISP_CMD_IUSBC: disp_USB_init(); break;
        case DISP_CMD_ERRLG:
            oled_put_ROMstr((rom char*) "SD write error", 3, 17); disp_cmd=0;
            break;
        case DISP_CMD_LOGNG:
            oled_cmd(OLEDREG_DISPLAY_OFF); disp_cmd=0;
            break;
    }
    return disp_cmd;
}

void disp_start_log(void) {
    disp_mode = DISP_MODE_LOGG;
    disp_cmd = DISP_CMD_LOGNG;
}
void disp_start_usb(void) {
    disp_mode = DISP_MODE_USBC;
    disp_cmd = DISP_CMD_IUSBC;
}

void disp_log_subdue(void) {
    if (disp_mode == DISP_MODE_TIME)
        oled_cmd(OLEDREG_DISPLAY_OFF);
}

void disp_log_revive(void) {
    if (disp_mode == DISP_MODE_TIME)
        oled_cmd(OLEDREG_DISPLAY_ON);
}

rom unsigned char porcpic[408] = {
 0, 0, 0, 0, 0, 0, 0, 0, 0, 0, 0, 0,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 0,
 0, 0, 0, 0, 0, 0, 0, 0, 0, 0, 0, 0,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 0,
 0, 0, 0, 0, 0, 0, 0, 0, 0, 0, 128, 64,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 0,
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 0, 0, 0, 0, 0, 0, 0, 0, 0, 7, 13, 8,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 0,
};

rom unsigned char bmp[10][140] =
{
    { 0,0,192,240,248,252,252,254,254,255,255,255,127,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0,0 },
    { 0,0,128,192,224,224,240,248,248,252,254,254,255,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252,0 },
    { 0,240,248,252,252,254,254,254,255,255,255,255,255,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254,16},
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    { 0,192,224,248,248,252,254,254,255,255,255,127,127,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0,0}
};
